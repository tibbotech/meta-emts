## conf/layer.conf
```bitbake
# We have a conf and classes directory, append to BBPATH
BBPATH .= ":${LAYERDIR}"

# We have recipes-* directories, add to BBFILES
BBFILES += "${LAYERDIR}/recipes-*/*/*.bb \
            ${LAYERDIR}/recipes-*/*/*.bbappend"

BBFILE_COLLECTIONS += "emts"
BBFILE_PATTERN_emts = "^${LAYERDIR}/"
BBFILE_PRIORITY_emts = "8"
LAYERVERSION_emts = "1"
LAYERSERIES_COMPAT_emts = "dunfell kirkstone scarthgap"
LAYERDEPENDS_emts  = "tibbo"

# Additional license directories.
LICENSE_PATH += "${LAYERDIR}/files/custom-licenses"
LICENSE_PATH += "${LAYERDIR}/files/common-licenses"

FILESDIR_emts := "${LAYERDIR}/files"

# The dynamic-layers directory hosts the extensions and layer specific
# modifications.
#
# The .bbappend and .bb files are included if the respective layer
# collection is available.
BBFILES += "${@' '.join('${LAYERDIR}/dynamic-layers/%s/recipes*/*/*.bbappend' % layer \
               for layer in BBFILE_COLLECTIONS.split())}"
BBFILES += "${@' '.join('${LAYERDIR}/dynamic-layers/%s/recipes*/*/*.bb' % layer \
               for layer in BBFILE_COLLECTIONS.split())}"
# or use strictly specified layer name:
#BBFILES_DYNAMIC += " \
#    otherlayer1:${LAYERDIR}/dynamic-layers/otherlayer1/recipes-*/*/*.bb \
#    otherlayer1:${LAYERDIR}/dynamic-layers/otherlayer1/recipes-*/*/*.bbappend \
#"
```
